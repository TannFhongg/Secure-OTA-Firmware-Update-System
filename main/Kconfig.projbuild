## main/Kconfig.projbuild
```kconfig
menu "Secure OTA Example"

    config EXAMPLE_FIRMWARE_UPGRADE_URL
        string "Firmware upgrade HTTPS URL"
        default "https://example.com/esp32-secure-ota.bin"
        help
            HTTPS URL of the firmware image. The OTA manager rejects plain HTTP.

    config EXAMPLE_AUTO_OTA_ON_BOOT
        bool "Run OTA check automatically on boot"
        default n
        help
            Enable only when a trusted HTTPS update server is available. Keeping
            this disabled avoids flashing the same image on every reset.

    config EXAMPLE_USE_CERT_BUNDLE
        bool "Use ESP x509 certificate bundle for OTA HTTPS"
        default y
        depends on MBEDTLS_CERTIFICATE_BUNDLE
        help
            Use the built-in trusted root certificate bundle for public HTTPS
            servers. For private/self-signed OTA servers, put the public server
            certificate at certs/ota_server_cert.pem; the OTA manager will pin
            that embedded certificate when it is present.

endmenu
```

## sdkconfig.defaults
```kconfig
# OTA Configuration

# Partition Table
CONFIG_PARTITION_TABLE_CUSTOM=y
CONFIG_PARTITION_TABLE_CUSTOM_FILENAME="partition_table/partitions.csv"

# Flash size must fit both OTA slots.
CONFIG_ESPTOOLPY_FLASHSIZE_4MB=y
CONFIG_ESPTOOLPY_FLASHSIZE="4MB"

CONFIG_BOOTLOADER_APP_ROLLBACK_ENABLE=y

# WiFi defaults. Put real credentials in local sdkconfig via idf.py menuconfig.
CONFIG_EXAMPLE_WIFI_SSID="YOUR_WIFI_SSID"
CONFIG_EXAMPLE_WIFI_PASSWORD="YOUR_WIFI_PASSWORD"

# OTA URL must be HTTPS. Configure the real URL locally with idf.py menuconfig.
CONFIG_EXAMPLE_FIRMWARE_UPGRADE_URL="https://example.com/esp32-secure-ota.bin"
# CONFIG_EXAMPLE_AUTO_OTA_ON_BOOT is not set

# HTTPS and certificate validation
# CONFIG_ESP_HTTPS_OTA_ALLOW_HTTP is not set
CONFIG_MBEDTLS_CERTIFICATE_BUNDLE=y
CONFIG_MBEDTLS_CERTIFICATE_BUNDLE_DEFAULT_CMN=y
CONFIG_EXAMPLE_USE_CERT_BUNDLE=y

# Production signed-app verification requires a signing key configured locally.
# Enable these in sdkconfig/menuconfig when the signing key is available:
# CONFIG_SECURE_SIGNED_APPS_NO_SECURE_BOOT=y
# CONFIG_SECURE_SIGNED_APPS_ECDSA_SCHEME=y

# Logging
CONFIG_LOG_DEFAULT_LEVEL_INFO=y
CONFIG_LOG_DEFAULT_LEVEL=3
```
